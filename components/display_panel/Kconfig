## components/display_panel/Kconfig
```kconfig
menu "Display Panel Configuration"

    choice DISPLAY_PANEL_PIXEL_FORMAT
        prompt "LCD pixel format"
        default DISPLAY_PANEL_RGB888
        help
            Select the pixel format used by the DPI frame buffers and LVGL.

        config DISPLAY_PANEL_RGB565
            bool "RGB565 (16 bpp)"
            help
                Use 16-bit RGB565 frame buffers to reduce PSRAM usage and
                MIPI DSI memory bandwidth.

        config DISPLAY_PANEL_RGB888
            bool "RGB888 (24 bpp)"
            help
                Use the panel-specified 24-bit RGB888 DPI format.

    endchoice

    config DISPLAY_PANEL_FRAME_BUFFER_COUNT
        int "Number of MIPI DPI frame buffers"
        range 1 2
        default 2
        help
            Select how many complete frame buffers the MIPI DPI driver owns.
            Partial LVGL rendering normally needs one; direct double-buffered
            rendering needs two.

endmenu
```

## components/t_panel_p4_bsp/Kconfig
```kconfig
menu "T-Panel-P4 Board Configuration"

    choice
        prompt "Select the board variant"
        default T_PANEL_P4_BOARD_STANDARD

        config T_PANEL_P4_BOARD_STANDARD
            bool "Standard"

        config T_PANEL_P4_BOARD_ROUND
            bool "Round"

        config T_PANEL_P4_BOARD_RECT
            bool "Rect"

    endchoice

    config T_PANEL_P4_BOARD_NAME
        string
        default "T-Panel-P4" if T_PANEL_P4_BOARD_STANDARD
        default "T-Panel-P4 Round" if T_PANEL_P4_BOARD_ROUND
        default "T-Panel-P4 Rect" if T_PANEL_P4_BOARD_RECT

    config T_PANEL_P4_HAS_LORA
        bool
        default y if T_PANEL_P4_BOARD_STANDARD || T_PANEL_P4_BOARD_ROUND
        default n

    config T_PANEL_P4_HAS_XL9555
        bool
        default y if T_PANEL_P4_BOARD_STANDARD || T_PANEL_P4_BOARD_ROUND
        default n

    config T_PANEL_P4_HAS_ESP32C5
        bool
        default y if T_PANEL_P4_BOARD_STANDARD || T_PANEL_P4_BOARD_ROUND
        default n

endmenu
```

## main/Kconfig.projbuild
```kconfig
menu "Example Configuration"

    choice
        prompt "Select the example to build"
        default EXAMPLE_FACTORY
                config EXAMPLE_FACTORY
                    bool "FACTORY"
                    select TINYUSB_MSC_ENABLED
                config EXAMPLE_XL9555
                    bool "XL9555"
                config EXAMPLE_LORA_SX1276
                    bool "LORA_SX1276"
                config EXAMPLE_LORA_SX1262
                    bool "LORA_SX1262"
                config EXAMPLE_LORA_LR1121
                    bool "LORA_LR1121"
                config EXAMPLE_AXP517
                    bool "AXP517"
                config EXAMPLE_LCD
                    bool "LCD"
                config EXAMPLE_AUDIO_PLAY_WAV
                    bool "AUDIO_PLAY_WAV"
                config EXAMPLE_AUDIO_RECORD
                    bool "AUDIO_RECORD"
                config EXAMPLE_AUDIO_LOOPBACK
                    bool "AUDIO_LOOPBACK"
                config EXAMPLE_CAMERA
                    bool "CAMERA"
                config EXAMPLE_CAMERA_ESP_VIDEO
                    bool "CAMERA_ESP_VIDEO"
                config EXAMPLE_ESP32P4_HOST_WIFI
                    bool "ESP32P4_HOST_WIFI"
                config EXAMPLE_ESP32P4_HOST_TEST
                    bool "ESP32P4_HOST_TEST"
                config EXAMPLE_SD
                    bool "SD"
                config EXAMPLE_SGM38121
                    bool "SGM38121"
                config EXAMPLE_LVGL
                    bool "LVGL"
                config EXAMPLE_USB_OTG_MSC
                    bool "USB_OTG_MSC"
                    select TINYUSB_MSC_ENABLED

    endchoice

endmenu
```

## main/examples/camera_esp_video/sdkconfig.defaults
```kconfig
CONFIG_CAMERA_OV2710=y
CONFIG_CAMERA_OV2710_MIPI_RAW10_1280X720_25FPS=y
CONFIG_CAMERA_OV2710_MIPI_RAW10_1920X1080_25FPS=y
# CONFIG_CAMERA_OV2710_MIPI_DEFAULT_FMT_RAW10_1280X720_25FPS is not set
CONFIG_CAMERA_OV2710_MIPI_DEFAULT_FMT_RAW10_1920X1080_25FPS=y
CONFIG_CAMERA_OV2710_MIPI_IF_FORMAT_INDEX_DEFAULT=0
CONFIG_DISPLAY_PANEL_RGB565=y
```

## main/examples/factory/sdkconfig.defaults
```kconfig
# Factory-only filesystem and USB settings.
CONFIG_TINYUSB_MSC_ENABLED=y
CONFIG_FATFS_VOLUME_COUNT=4
CONFIG_FATFS_LFN_HEAP=y
CONFIG_FATFS_MAX_LFN=255
CONFIG_FATFS_CODEPAGE_936=y
CONFIG_FATFS_CODEPAGE=936
CONFIG_FATFS_API_ENCODING_UTF_8=y
# CONFIG_FATFS_PER_FILE_CACHE is not set
CONFIG_VFS_MAX_COUNT=16

# Factory camera settings.
CONFIG_CAMERA_OV2710=y
CONFIG_CAMERA_OV2710_MIPI_RAW10_1280X720_25FPS=y
CONFIG_CAMERA_OV2710_MIPI_RAW10_1920X1080_25FPS=y
CONFIG_CAMERA_OV2710_MIPI_DEFAULT_FMT_RAW10_1280X720_25FPS=y
# CONFIG_CAMERA_OV2710_MIPI_DEFAULT_FMT_RAW10_1920X1080_25FPS is not set
CONFIG_CAMERA_OV2710_MIPI_IF_FORMAT_INDEX_DEFAULT=1

# Factory LVGL settings.
CONFIG_LV_COLOR_DEPTH_24=y
CONFIG_LV_DEF_REFR_PERIOD=20
CONFIG_LV_DRAW_BUF_ALIGN=64
# Use the system heap so dynamic pages can spill into PSRAM instead of being
# constrained by LVGL's default 64 KB fixed pool.
# CONFIG_LV_USE_BUILTIN_MALLOC is not set
CONFIG_LV_USE_CLIB_MALLOC=y
CONFIG_LV_FONT_MONTSERRAT_12=y
CONFIG_LV_FONT_MONTSERRAT_14=y
CONFIG_LV_FONT_MONTSERRAT_16=y
CONFIG_LV_FONT_MONTSERRAT_20=y
CONFIG_LV_FONT_MONTSERRAT_24=y
CONFIG_LV_FONT_MONTSERRAT_28=y
CONFIG_LV_FONT_MONTSERRAT_32=y
CONFIG_LV_FONT_MONTSERRAT_36=y
CONFIG_LV_FONT_MONTSERRAT_40=y
CONFIG_LV_FONT_SOURCE_HAN_SANS_SC_16_CJK=y
CONFIG_LV_FONT_DEFAULT_MONTSERRAT_20=y
CONFIG_LV_USE_SYSMON=y
# CONFIG_LV_USE_PERF_MONITOR is not set
CONFIG_LV_USE_LODEPNG=y
CONFIG_LV_USE_FLOAT=y
# CONFIG_LV_BUILD_EXAMPLES is not set
# CONFIG_LV_BUILD_DEMOS is not set
CONFIG_DISPLAY_PANEL_FRAME_BUFFER_COUNT=1

# Factory audio player settings.
CONFIG_ESP_AUDIO_SIMPLE_PLAYER_FILE_EN=y
CONFIG_ESP_AUDIO_SIMPLE_PLAYER_RESAMPLE_EN=y
CONFIG_AUDIO_SIMPLE_PLAYER_RESAMPLE_DEST_RATE=48000
CONFIG_ESP_AUDIO_SIMPLE_PLAYER_CH_CVT_EN=y
CONFIG_AUDIO_SIMPLE_PLAYER_CH_CVT_DEST=2
CONFIG_ESP_AUDIO_SIMPLE_PLAYER_BIT_CVT_EN=y
CONFIG_AUDIO_SIMPLE_PLAYER_BIT_CVT_DEST_16BIT=y
CONFIG_AUDIO_SIMPLE_PLAYER_BIT_CVT_DEST_BITS=16
```

## main/examples/lvgl/sdkconfig.defaults
```kconfig
CONFIG_LV_COLOR_DEPTH_24=y
CONFIG_LV_DRAW_BUF_ALIGN=64
# CONFIG_LV_BUILD_EXAMPLES is not set
# CONFIG_LV_BUILD_DEMOS is not set
```
